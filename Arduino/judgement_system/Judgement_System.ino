#include <string.h>
#include <stdio.h>
#include <stdlib.h>
#include <stdint.h>

#define SHARED_SIZE 8
#define PTR_SIZE 1
#define PTR_TYPE 4

/* 
	holds the information about the robot's position
*/

typedef struct __attribute__((packed)) {
	uint8_t flag;
	uint32_t x;
	uint32_t y;
	uint32_t z;
	uint32_t compass;
} GPS_DATA;


/*
	holds the general information of the robot's status including
	remaining time, remaining life, chassis voltage & current, rune status,
	conveyorBelts & airport status and robot's location information.	
*/

typedef struct __attribute__((packed)) {
	uint32_t remainTime;
	uint16_t remainLifeValue;
	float realChassisOutV;
	float realChassisOutA;
	uint8_t runeStatus[4];
	uint8_t bigRune0Status;
	uint8_t bigRune1status;
	uint8_t conveyorBelts0:2;
	uint8_t conveyorBelts1:2;
	uint8_t parkingApron0:1;
	uint8_t parkingApron1:1;
	uint8_t parkingApron2:1;
	uint8_t parkingApron3:1;
	GPS_DATA *gps_data;
} GENERAL_INFO;


/*
	holds the information about health change, it could tell which armor
	is hitten, the cause of the health decrease and the value of health decrease.
*/

typedef struct __attribute__((packed)) {
	uint8_t weakId:4;
	uint8_t way:4;
	uint16_t value;
} HEALTH_DATA;


/*
	holds the information about the weapon, includes the projectile's speed and
	frequency for both 17mm bullet and golf.
*/

typedef struct __attribute__((packed)) {
	float realBulletShootSpeed;
	float realBulletShootFreq;
	float realGolfShootSpeed;
	float realGolfShootFreq;
} WEAPON_DATA;


/* 
	CRC8 check code, provided by DJI.
	crc8 generator polynomial:G(x)=x8+x5+x4+1
*/

const unsigned char CRC8_INIT = 0xff;
const unsigned char CRC8_TAB[256] = {
	0x00, 0x5e, 0xbc, 0xe2, 0x61, 0x3f, 0xdd, 0x83, 0xc2, 0x9c, 0x7e, 0x20, 0xa3, 0xfd, 0x1f, 0x41,
	0x9d, 0xc3, 0x21, 0x7f, 0xfc, 0xa2, 0x40, 0x1e, 0x5f, 0x01, 0xe3, 0xbd, 0x3e, 0x60, 0x82, 0xdc,
	0x23, 0x7d, 0x9f, 0xc1, 0x42, 0x1c, 0xfe, 0xa0, 0xe1, 0xbf, 0x5d, 0x03, 0x80, 0xde, 0x3c, 0x62,
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	0x74, 0x2a, 0xc8, 0x96, 0x15, 0x4b, 0xa9, 0xf7, 0xb6, 0xe8, 0x0a, 0x54, 0xd7, 0x89, 0x6b, 0x35,
};

unsigned char Get_CRC8_Check_Sum(unsigned char *pchMessage, unsigned int dwLength, unsigned char ucCRC8) {

	unsigned char ucIndex;

	while (dwLength--) {
		ucIndex = ucCRC8^(*pchMessage++);
		ucCRC8 = CRC8_TAB[ucIndex];
	}

	return(ucCRC8);
}


/*
	** Descriptions: CRC8 Verify function
	** Input: Data to Verify,Stream length = Data + checksum
 	** Output: True or False (CRC Verify Result)
*/

unsigned int Verify_CRC8_Check_Sum(unsigned char *pchMessage, unsigned int dwLength) {

	unsigned char ucExpected = 0;

	if ((pchMessage == 0) || (dwLength <= 2)) 
		return 0;
	
	ucExpected = Get_CRC8_Check_Sum (pchMessage, dwLength-1, CRC8_INIT);
	return ( ucExpected == pchMessage[dwLength-1] );
}


/*
	CRC8 check code ends, CRC16 check code begins
*/

uint16_t CRC_INIT = 0xffff;

const uint16_t wCRC_Table[256] = {
	0x0000, 0x1189, 0x2312, 0x329b, 0x4624, 0x57ad, 0x6536, 0x74bf,
	0x8c48, 0x9dc1, 0xaf5a, 0xbed3, 0xca6c, 0xdbe5, 0xe97e, 0xf8f7,
	0x1081, 0x0108, 0x3393, 0x221a, 0x56a5, 0x472c, 0x75b7, 0x643e,
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	0x7bc7, 0x6a4e, 0x58d5, 0x495c, 0x3de3, 0x2c6a, 0x1ef1, 0x0f78
};


/*
	** Descriptions: CRC16 checksum function
 	** Input: Data to check,Stream length, initialized checksum
 	** Output: CRC checksum
*/

uint16_t Get_CRC16_Check_Sum(uint8_t *pchMessage, uint32_t dwLength, uint16_t wCRC) {

	uint8_t chData;

	if (pchMessage == NULL) {
		return 0xFFFF;
	}

	while(dwLength--) {
		chData = *pchMessage++;
		(wCRC) = ((uint16_t)(wCRC) >> 8) ^ wCRC_Table[((uint16_t)(wCRC) ^ (uint16_t)(chData)) & 0x00ff];
	}

	return wCRC;
}


/*
	** Descriptions: CRC16 Verify function
 	** Input: Data to Verify,Stream length = Data + checksum
	** Output: True or False (CRC Verify Result)
*/

uint32_t Verify_CRC16_Check_Sum(uint8_t *pchMessage, uint32_t dwLength) {

	uint16_t wExpected = 0;

	if ((pchMessage == NULL) || (dwLength <= 2)) {
		return 0;
	}

	wExpected = Get_CRC16_Check_Sum ( pchMessage, dwLength - 2, CRC_INIT);
	return ((wExpected & 0xff) == pchMessage[dwLength - 2] && 
			((wExpected >> 8) & 0xff) == pchMessage[dwLength - 1]);
}

/*
	CRC16 check code ends.
*/


// data structurs which store the information obtained from judgement system
GENERAL_INFO *general_info;
HEALTH_DATA *health_data;
WEAPON_DATA *weapon_data;


// The byte read from judgement system

unsigned char rx_byte;


// read one byte from judgement system

void read_one();


/* 
	**description: reciving the data from the judgement system and put them into
	different data structure according to the different data type.
	
	**input: SOF, in this case the byte A5 received from judgement system

	**output: none, data will be store in the globally declared & initiallized
	data structure  
*/

void receive(unsigned char SOF) {

	unsigned char buffer_1[4];
	uint16_t data_size;  
	uint16_t data_type; 

	buffer_1[0] = SOF;
	int itr = 1;

    while (itr < 4) {
    	read_one();
    	buffer_1[itr] = rx_byte;
    	itr++;
    }
    if (Verify_CRC8_Check_Sum(buffer_1, 4)) {
    	data_size = buffer_1[1];
    	unsigned char buffer_2[SHARED_SIZE + data_size];
    	memcpy(buffer_2, buffer_1, 4);
    	while (itr < SHARED_SIZE + data_size) {
        	read_one();
        	buffer_2[itr] = rx_byte;
        	itr++;
      	}
	
		// sometimes it does not pass the CRC test because the data is corrupted
      	if (Verify_CRC16_Check_Sum(buffer_2, SHARED_SIZE + data_size)) {        	
			data_type = buffer_2[5];
		
			// at this point we have got all the data from the js into the buffer_2 
        	if (data_type == 1) {
          		memcpy(general_info, buffer_2 + 6, 20);
          		general_info->conveyorBelts0 = buffer_2[26] & 3;
          		general_info->conveyorBelts1 = (buffer_2[26] >> 2) & 3;
          		general_info->parkingApron0 = (buffer_2[26] >> 4) & 1;
          		general_info->parkingApron0 = (buffer_2[26] >> 5) & 1;
          		general_info->parkingApron0 = (buffer_2[26] >> 6) & 1;
          		general_info->parkingApron0 = (buffer_2[26] >> 7) & 1;
          		memcpy(general_info->gps_data, buffer_2 + 27, 17);
        	} else if (data_type == 2) {
          		health_data->weakId = buffer_2[6];  
          		health_data->way = (buffer_2[6] >> 4) & 15;
          		memcpy(&(health_data->value), buffer_2 + 7, 2);
        	} else if (data_type == 3) {
          		memcpy(weapon_data, buffer_2 + 6, data_size);
        	}
      	}
    }
}

void read_one() {
  while (!Serial3.available()){}
  rx_byte = Serial3.read();
}

void setup() {

  Serial.begin(115200);
  while (!Serial.available()){}
  Serial3.begin(115200);

  general_info = (GENERAL_INFO *) malloc(sizeof(general_info));

  general_info->gps_data = (GPS_DATA *) malloc(sizeof(GPS_DATA));

  health_data = (HEALTH_DATA *) malloc(sizeof(health_data));

  weapon_data = (WEAPON_DATA *) malloc(sizeof(weapon_data));

}

/*
	keep reading from the judgment system until it receive the SOF, then it will
	process the data from the judgment system and store it into the data structure.
*/
void loop() {
  while (1) {
    read_one();
    if (rx_byte == 165) {
      receive(rx_byte);
    }
  }
}
